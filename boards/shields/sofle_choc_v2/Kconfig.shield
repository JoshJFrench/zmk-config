## boards/shields/sofle_choc_v2/Kconfig.shield
```kconfig
config SHIELD_SOFLE_CHOC_V2_LEFT
    def_bool $(shields_list_contains,sofle_choc_v2_left)

config SHIELD_SOFLE_CHOC_V2_RIGHT
    def_bool $(shields_list_contains,sofle_choc_v2_right)
```

## boards/shields/sofle_choc_v2_left/Kconfig.defconfig
```kconfig
# Left side configuration
if SHIELD_SOFLE_CHOC_V2_LEFT

config ZMK_KEYBOARD_NAME
    default "Sofle Choc V2"

config ZMK_SPLIT_ROLE_CENTRAL
    default y # Sets this half as the Master

config ZMK_SPLIT
    default y

endif
```

## boards/shields/sofle_choc_v2_right/Kconfig.defconfig
```kconfig
# Right side configuration
if SHIELD_SOFLE_CHOC_V2_RIGHT

config ZMK_KEYBOARD_NAME
    default "Sofle Choc V2"

config ZMK_SPLIT_ROLE_CENTRAL
    default n # Sets this half as the Peripheral (Slave)

config ZMK_SPLIT
    default y

endif
```

## boards/shields/sofle_choc_v2_right/Kconfig.shield
```kconfig
config SHIELD_SOFLE_CHOC_V2_RIGHT
    def_bool $(shields_list_contains,sofle_choc_v2_right)
```
