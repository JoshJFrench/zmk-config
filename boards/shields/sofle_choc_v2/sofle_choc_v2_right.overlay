/*
 * Copyright (c) 2020 The ZMK Project Contributors [cite: 1]
 *
 * SPDX-License-Identifier: MIT [cite: 1]
 */

#include "sofle_choc_v2.dtsi"

// RIGHT SIDE: Transforms columns 6-11
&default_transform {
    col-offset = <6>; [cite: 1]
};

// Enables the right encoder [cite: 4]
&right_encoder {
    status = "okay"; [cite: 4]
    // Add the press binding for the right encoder switch (MUTE/UNMUTE)
    bindings = <
        &trans // CW
        &trans // CCW
        &trans // Press (no action)
    >;
};