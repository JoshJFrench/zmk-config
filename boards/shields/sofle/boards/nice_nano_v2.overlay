/*
 * Copyright (c) 2020 The ZMK Contributors
 *
 * SPDX-License-Identifier: MIT
 */

// Custom pin assignments for Sofle Choc V2

&left_encoder {
    a-gpios = <&gpio0 29 (GPIO_ACTIVE_LOW | GPIO_PULL_UP)>;
    b-gpios = <&gpio0 31 (GPIO_ACTIVE_LOW | GPIO_PULL_UP)>;
    steps = <80>;
};

&right_encoder {
    a-gpios = <&gpio0 31 (GPIO_ACTIVE_LOW | GPIO_PULL_UP)>;
    b-gpios = <&gpio0 29 (GPIO_ACTIVE_LOW | GPIO_PULL_UP)>;
    steps = <80>;
};

// OLED I2C pin assignments  
&pro_micro_i2c {
    sda-gpios = <&gpio0 17 GPIO_ACTIVE_HIGH>;
    scl-gpios = <&gpio0 20 GPIO_ACTIVE_HIGH>;
};